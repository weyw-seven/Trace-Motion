#ifndef TRAJECTORY_EXECUTOR_H
#define TRAJECTORY_EXECUTOR_H

/*
 * trajectory_executor.h
 *
 * Nominal trajectory executor for the V1 trajectory system.
 *
 * Responsibilities:
 *   trajectory_decoder_t / trajectory_segment_t stream
 *      -> current / next segment management
 *      -> geometry continuity validation
 *      -> 1-D path motion profile in unified arc-length s_mm
 *      -> continuous trajectory_reference_t samples
 *
 * This module deliberately does NOT:
 *   - read chassis odometry
 *   - close the tracking error loop
 *   - convert world-frame velocity to body-frame velocity
 *   - command motor_set_velocity()
 *
 * Those responsibilities belong to trajectory_tracker.h.
 *
 * Coordinate convention inherited from trajectory_decoder.h:
 *   +X          : forward / world +X at trajectory start
 *   +Y          : left    / world +Y at trajectory start
 *   angle > 0   : counter-clockwise
 *
 * Units:
 *   position / path length : mm
 *   linear speed           : mm/s
 *   linear acceleration    : mm/s^2
 *   angle                  : degree
 *   curvature              : 1/mm
 *
 * Motion model:
 *   - every geometry type is parameterized by path distance s_mm
 *   - LINE   : s_mm -> linear interpolation along the segment
 *   - CIRCLE : s_mm -> signed angular advance around the circle
 *   - speed is generated by a trapezoidal / braking-limited 1-D profile
 *   - one-segment lookahead preserves speed across tangent-continuous
 *     junctions and requests zero exit speed at sharp corners / trajectory end
 *
 * Single-header usage:
 *
 *   In exactly ONE .c/.cpp file:
 *
 *       #define TRAJECTORY_EXECUTOR_IMPLEMENTATION
 *       #include "trajectory_executor.h"
 *
 *   In all other .c/.cpp files:
 *
 *       #include "trajectory_executor.h"
 *
 * Required lower-layer public contract:
 *   trajectory_decoder.h
 *
 * Intended next-layer contract:
 *   trajectory_tracker.h should include this header and consume
 *   trajectory_reference_t. The tracker may obtain the trajectory-wide
 *   start pose / start yaw through trajectory_executor_get_header().
 */

#include <stdint.h>
#include <stdbool.h>
#include <stddef.h>
#include <math.h>

#include "esp_err.h"
#include "trajectory_decoder.h"

#ifdef __cplusplus
extern "C" {
#endif


/* ============================================================
 * 1. Configuration
 * ============================================================ */

/*
 * Used when segment.acceleration_mm_s2 == 0.
 * Override before including this header if needed.
 */
#ifndef TRAJECTORY_EXECUTOR_DEFAULT_ACCELERATION_MM_S2
#define TRAJECTORY_EXECUTOR_DEFAULT_ACCELERATION_MM_S2  1200.0f
#endif

/*
 * CIRCLE has an implicit start point from center/radius/start_angle.
 * It must agree with the previous logical segment endpoint within this
 * tolerance. PC-generated files should normally be far more accurate.
 */
#ifndef TRAJECTORY_EXECUTOR_CONTINUITY_TOLERANCE_MM
#define TRAJECTORY_EXECUTOR_CONTINUITY_TOLERANCE_MM      2.0f
#endif

/*
 * A junction is considered tangent-continuous when the angle between the
 * outgoing and incoming unit tangents does not exceed this threshold.
 */
#ifndef TRAJECTORY_EXECUTOR_TANGENT_TOLERANCE_DEG
#define TRAJECTORY_EXECUTOR_TANGENT_TOLERANCE_DEG        5.0f
#endif

/* Reject degenerate geometry shorter than this value. */
#ifndef TRAJECTORY_EXECUTOR_LENGTH_EPSILON_MM
#define TRAJECTORY_EXECUTOR_LENGTH_EPSILON_MM            1.0e-3f
#endif

#ifndef TRAJECTORY_EXECUTOR_SPEED_EPSILON_MM_S
#define TRAJECTORY_EXECUTOR_SPEED_EPSILON_MM_S           1.0e-3f
#endif

/*
 * Large caller dt values are internally split into smaller motion-profile
 * steps. This makes acceleration/braking behavior less sensitive to task
 * jitter without creating a background task in this module.
 */
#ifndef TRAJECTORY_EXECUTOR_PROFILE_SUBSTEP_MAX_S
#define TRAJECTORY_EXECUTOR_PROFILE_SUBSTEP_MAX_S        0.020f
#endif

/* Hard safety guard against accidentally passing a nonsensical dt. */
#ifndef TRAJECTORY_EXECUTOR_UPDATE_DT_MAX_S
#define TRAJECTORY_EXECUTOR_UPDATE_DT_MAX_S              1.000f
#endif

#define TRAJECTORY_EXECUTOR_PI                           3.14159265358979323846f
#define TRAJECTORY_EXECUTOR_DEG_TO_RAD                   0.01745329251994329577f


/* ============================================================
 * 2. Public state / error types
 * ============================================================ */

typedef enum
{
    TRAJECTORY_EXECUTOR_IDLE = 0,
    TRAJECTORY_EXECUTOR_RUNNING,
    TRAJECTORY_EXECUTOR_PAUSED,
    TRAJECTORY_EXECUTOR_FINISHED,
    TRAJECTORY_EXECUTOR_ERROR

} trajectory_executor_state_t;


typedef enum
{
    TRAJECTORY_EXECUTOR_ERROR_NONE = 0,
    TRAJECTORY_EXECUTOR_ERROR_NOT_INITIALIZED,
    TRAJECTORY_EXECUTOR_ERROR_INVALID_ARGUMENT,
    TRAJECTORY_EXECUTOR_ERROR_DECODER,
    TRAJECTORY_EXECUTOR_ERROR_INVALID_GEOMETRY,
    TRAJECTORY_EXECUTOR_ERROR_DISCONTINUITY,
    TRAJECTORY_EXECUTOR_ERROR_INVALID_DT

} trajectory_executor_error_t;


/* ============================================================
 * 3. Unified reference for trajectory_tracker.h
 * ============================================================ */

/*
 * This is the frozen boundary between executor and tracker.
 *
 * Position, tangent and curvature are WORLD-frame path quantities.
 * speed_mm_s is a non-negative scalar path speed.
 * acceleration_mm_s2 is signed longitudinal path acceleration.
 *
 * The tracker should normally form world-frame feedforward as:
 *
 *     vx_ff_world = tangent_x * speed_mm_s
 *     vy_ff_world = tangent_y * speed_mm_s
 *
 * then add odometry-based feedback and rotate the final world command into
 * the chassis/body frame before calling motor_set_velocity().
 */
typedef struct
{
    bool valid;

    uint32_t segment_index;
    trajectory_segment_type_t source_type;

    /* Desired world-frame position. */
    float x_mm;
    float y_mm;

    /* Unit tangent in world frame. */
    float tangent_x;
    float tangent_y;

    /* Signed geometric curvature: LINE=0, CCW circle=+1/R, CW=-1/R. */
    float curvature_inv_mm;

    /* Current 1-D motion-profile reference. */
    float speed_mm_s;
    float acceleration_mm_s2;

    /* Current segment progress. */
    float s_mm;
    float segment_length_mm;
    float progress;

    /* Event flags. They are informational; valid remains true. */
    bool segment_start;
    bool segment_end;
    bool trajectory_end;

} trajectory_reference_t;


/* ============================================================
 * 4. Executor instance
 * ============================================================ */

typedef struct
{
    bool initialized;

    trajectory_decoder_t *decoder;
    trajectory_file_header_t header;

    trajectory_executor_state_t state;
    trajectory_executor_error_t error;

    trajectory_segment_t current_segment;
    trajectory_segment_t next_segment;

    bool current_valid;
    bool next_valid;

    uint32_t current_index;

    /* Current segment geometry in world frame. */
    float segment_start_x_mm;
    float segment_start_y_mm;
    float segment_end_x_mm;
    float segment_end_y_mm;

    float segment_start_tangent_x;
    float segment_start_tangent_y;
    float segment_end_tangent_x;
    float segment_end_tangent_y;

    float segment_length_mm;

    /* Unified arc-length progress and motion profile. */
    float s_mm;
    float speed_mm_s;
    float acceleration_mm_s2;
    float exit_speed_mm_s;

    /* Internal event/state helpers. */
    bool first_reference;
    bool pending_advance;

    trajectory_reference_t last_reference;

} trajectory_executor_t;


#define TRAJECTORY_EXECUTOR_INITIALIZER       \
    {                                         \
        .initialized = false,                 \
        .decoder = NULL,                      \
        .header = {0},                        \
        .state = TRAJECTORY_EXECUTOR_IDLE,    \
        .error = TRAJECTORY_EXECUTOR_ERROR_NONE, \
        .current_segment = {0},               \
        .next_segment = {0},                  \
        .current_valid = false,               \
        .next_valid = false,                  \
        .current_index = 0U,                  \
        .segment_start_x_mm = 0.0f,           \
        .segment_start_y_mm = 0.0f,           \
        .segment_end_x_mm = 0.0f,             \
        .segment_end_y_mm = 0.0f,             \
        .segment_start_tangent_x = 0.0f,      \
        .segment_start_tangent_y = 0.0f,      \
        .segment_end_tangent_x = 0.0f,        \
        .segment_end_tangent_y = 0.0f,        \
        .segment_length_mm = 0.0f,            \
        .s_mm = 0.0f,                         \
        .speed_mm_s = 0.0f,                   \
        .acceleration_mm_s2 = 0.0f,           \
        .exit_speed_mm_s = 0.0f,              \
        .first_reference = false,             \
        .pending_advance = false,              \
        .last_reference = {0}                 \
    }


/* ============================================================
 * 5. Public API
 * ============================================================ */

/**
 * @brief Bind an already-open trajectory decoder to an executor.
 *
 * This does not consume any segment. trajectory_executor_start() rewinds the
 * decoder before beginning execution.
 */
esp_err_t trajectory_executor_init(
    trajectory_executor_t *executor,
    trajectory_decoder_t *decoder);


/**
 * @brief Rewind the decoder and start/restart nominal trajectory execution.
 *
 * The first segment starts at header.start_x_mm/header.start_y_mm.
 * Initial path speed is zero. Empty trajectories become FINISHED immediately.
 */
esp_err_t trajectory_executor_start(
    trajectory_executor_t *executor);


/**
 * @brief Advance the nominal trajectory by dt_s and return one reference.
 *
 * No odometry is consumed here. Call this at the trajectory loop period
 * (typically 10 ms), then pass the returned reference to trajectory_tracker.
 *
 * FINISHED and PAUSED states continue to return a valid stationary reference.
 */
esp_err_t trajectory_executor_update(
    trajectory_executor_t *executor,
    float dt_s,
    trajectory_reference_t *reference);


/**
 * @brief Pause at the current nominal path position.
 *
 * Path speed becomes zero immediately; resume() accelerates again from zero.
 */
esp_err_t trajectory_executor_pause(
    trajectory_executor_t *executor);


/**
 * @brief Resume a paused trajectory from the same nominal path position.
 */
esp_err_t trajectory_executor_resume(
    trajectory_executor_t *executor);


/**
 * @brief Stop execution and return the runtime state to IDLE.
 *
 * The decoder remains open and bound. start() may be called again.
 */
void trajectory_executor_stop(
    trajectory_executor_t *executor);


bool trajectory_executor_is_running(
    const trajectory_executor_t *executor);


bool trajectory_executor_is_finished(
    const trajectory_executor_t *executor);


trajectory_executor_state_t trajectory_executor_get_state(
    const trajectory_executor_t *executor);


trajectory_executor_error_t trajectory_executor_get_error(
    const trajectory_executor_t *executor);


/**
 * @brief Copy the latest reference without advancing time.
 *
 * This is useful for logging and is also a clean handoff point for the next
 * trajectory_tracker.h layer.
 */
esp_err_t trajectory_executor_get_reference(
    const trajectory_executor_t *executor,
    trajectory_reference_t *reference);


/**
 * @brief Copy the trajectory file header cached at init/start.
 *
 * In particular, trajectory_tracker may use header.start_yaw_deg as the
 * initial heading-hold target without depending directly on the decoder.
 */
esp_err_t trajectory_executor_get_header(
    const trajectory_executor_t *executor,
    trajectory_file_header_t *header);


const char *trajectory_executor_state_name(
    trajectory_executor_state_t state);


const char *trajectory_executor_error_name(
    trajectory_executor_error_t error);


#ifdef __cplusplus
}
#endif


/* ============================================================
 * IMPLEMENTATION
 * ============================================================ */

#ifdef TRAJECTORY_EXECUTOR_IMPLEMENTATION

#include <string.h>
#include "esp_log.h"

#ifdef __cplusplus
extern "C" {
#endif

#define TRAJECTORY_EXECUTOR_TAG "traj_executor"


typedef struct
{
    float start_x_mm;
    float start_y_mm;
    float end_x_mm;
    float end_y_mm;

    float start_tangent_x;
    float start_tangent_y;
    float end_tangent_x;
    float end_tangent_y;

    float length_mm;

} trajectory_executor_geometry_info_t;


static float trajectory_executor_clampf(
    float value,
    float low,
    float high)
{
    if (value < low)
    {
        return low;
    }

    if (value > high)
    {
        return high;
    }

    return value;
}


static float trajectory_executor_minf(
    float a,
    float b)
{
    return (a < b) ? a : b;
}


static float trajectory_executor_absf(
    float value)
{
    return (value < 0.0f) ? -value : value;
}


static float trajectory_executor_hypot2(
    float x,
    float y)
{
    return sqrtf((x * x) + (y * y));
}


static float trajectory_executor_wrap_rad_pi(
    float angle_rad)
{
    angle_rad =
        fmodf(
            angle_rad + TRAJECTORY_EXECUTOR_PI,
            2.0f * TRAJECTORY_EXECUTOR_PI);

    if (angle_rad < 0.0f)
    {
        angle_rad +=
            2.0f * TRAJECTORY_EXECUTOR_PI;
    }

    return angle_rad - TRAJECTORY_EXECUTOR_PI;
}


static float trajectory_executor_segment_acceleration_limit(
    const trajectory_segment_t *segment)
{
    if (segment == NULL)
    {
        return 0.0f;
    }

    if (segment->acceleration_mm_s2 > 0.0f)
    {
        return segment->acceleration_mm_s2;
    }

    return TRAJECTORY_EXECUTOR_DEFAULT_ACCELERATION_MM_S2;
}


static void trajectory_executor_clear_reference(
    trajectory_reference_t *reference)
{
    if (reference != NULL)
    {
        memset(
            reference,
            0,
            sizeof(*reference));
    }
}


static esp_err_t trajectory_executor_fail(
    trajectory_executor_t *executor,
    trajectory_executor_error_t error,
    esp_err_t ret,
    const char *message)
{
    if (executor != NULL)
    {
        executor->state =
            TRAJECTORY_EXECUTOR_ERROR;

        executor->error =
            error;

        executor->speed_mm_s =
            0.0f;

        executor->acceleration_mm_s2 =
            0.0f;

        executor->last_reference.speed_mm_s =
            0.0f;

        executor->last_reference.acceleration_mm_s2 =
            0.0f;
    }

    if (message != NULL)
    {
        ESP_LOGE(
            TRAJECTORY_EXECUTOR_TAG,
            "%s",
            message);
    }

    return ret;
}


static esp_err_t trajectory_executor_geometry_info(
    const trajectory_segment_t *segment,
    float logical_start_x_mm,
    float logical_start_y_mm,
    trajectory_executor_geometry_info_t *info,
    bool enforce_continuity)
{
    if ((segment == NULL) || (info == NULL))
    {
        return ESP_ERR_INVALID_ARG;
    }

    memset(
        info,
        0,
        sizeof(*info));

    if (!isfinite(segment->speed_mm_s) ||
        !isfinite(segment->acceleration_mm_s2) ||
        (segment->speed_mm_s <= 0.0f) ||
        (segment->acceleration_mm_s2 < 0.0f))
    {
        return ESP_ERR_INVALID_ARG;
    }

    switch (segment->type)
    {
        case TRAJECTORY_SEGMENT_LINE:
        {
            const float end_x =
                segment->geometry.line.end_x_mm;

            const float end_y =
                segment->geometry.line.end_y_mm;

            if (!isfinite(end_x) ||
                !isfinite(end_y) ||
                !isfinite(logical_start_x_mm) ||
                !isfinite(logical_start_y_mm))
            {
                return ESP_ERR_INVALID_ARG;
            }

            const float dx =
                end_x - logical_start_x_mm;

            const float dy =
                end_y - logical_start_y_mm;

            const float length =
                trajectory_executor_hypot2(dx, dy);

            if (!(length > TRAJECTORY_EXECUTOR_LENGTH_EPSILON_MM))
            {
                return ESP_ERR_INVALID_SIZE;
            }

            const float inv_length =
                1.0f / length;

            const float tx =
                dx * inv_length;

            const float ty =
                dy * inv_length;

            info->start_x_mm =
                logical_start_x_mm;

            info->start_y_mm =
                logical_start_y_mm;

            info->end_x_mm =
                end_x;

            info->end_y_mm =
                end_y;

            info->start_tangent_x = tx;
            info->start_tangent_y = ty;
            info->end_tangent_x = tx;
            info->end_tangent_y = ty;
            info->length_mm = length;

            return ESP_OK;
        }

        case TRAJECTORY_SEGMENT_CIRCLE:
        {
            const trajectory_circle_t *circle =
                &segment->geometry.circle;

            if (!isfinite(circle->center_x_mm) ||
                !isfinite(circle->center_y_mm) ||
                !isfinite(circle->radius_mm) ||
                !isfinite(circle->start_angle_deg) ||
                !isfinite(circle->sweep_deg) ||
                (circle->radius_mm <= 0.0f) ||
                (trajectory_executor_absf(circle->sweep_deg) < 1.0e-6f))
            {
                return ESP_ERR_INVALID_ARG;
            }

            const float start_angle_rad =
                circle->start_angle_deg *
                TRAJECTORY_EXECUTOR_DEG_TO_RAD;

            const float sweep_rad =
                circle->sweep_deg *
                TRAJECTORY_EXECUTOR_DEG_TO_RAD;

            const float end_angle_rad =
                start_angle_rad + sweep_rad;

            const float start_trig =
                trajectory_executor_wrap_rad_pi(
                    start_angle_rad);

            const float end_trig =
                trajectory_executor_wrap_rad_pi(
                    end_angle_rad);

            const float start_x =
                circle->center_x_mm +
                circle->radius_mm * cosf(start_trig);

            const float start_y =
                circle->center_y_mm +
                circle->radius_mm * sinf(start_trig);

            const float end_x =
                circle->center_x_mm +
                circle->radius_mm * cosf(end_trig);

            const float end_y =
                circle->center_y_mm +
                circle->radius_mm * sinf(end_trig);

            const float continuity_error =
                trajectory_executor_hypot2(
                    start_x - logical_start_x_mm,
                    start_y - logical_start_y_mm);

            if (enforce_continuity &&
                (continuity_error >
                 TRAJECTORY_EXECUTOR_CONTINUITY_TOLERANCE_MM))
            {
                return ESP_ERR_INVALID_RESPONSE;
            }

            const float direction =
                (circle->sweep_deg > 0.0f) ? 1.0f : -1.0f;

            const float start_sin =
                sinf(start_trig);

            const float start_cos =
                cosf(start_trig);

            const float end_sin =
                sinf(end_trig);

            const float end_cos =
                cosf(end_trig);

            const float length =
                circle->radius_mm *
                trajectory_executor_absf(sweep_rad);

            if (!(length > TRAJECTORY_EXECUTOR_LENGTH_EPSILON_MM) ||
                !isfinite(length))
            {
                return ESP_ERR_INVALID_SIZE;
            }

            info->start_x_mm = start_x;
            info->start_y_mm = start_y;
            info->end_x_mm = end_x;
            info->end_y_mm = end_y;

            info->start_tangent_x =
                direction * (-start_sin);

            info->start_tangent_y =
                direction * start_cos;

            info->end_tangent_x =
                direction * (-end_sin);

            info->end_tangent_y =
                direction * end_cos;

            info->length_mm = length;

            return ESP_OK;
        }

        default:
            return ESP_ERR_NOT_SUPPORTED;
    }
}


static void trajectory_executor_store_current_geometry(
    trajectory_executor_t *executor,
    const trajectory_executor_geometry_info_t *info)
{
    executor->segment_start_x_mm =
        info->start_x_mm;

    executor->segment_start_y_mm =
        info->start_y_mm;

    executor->segment_end_x_mm =
        info->end_x_mm;

    executor->segment_end_y_mm =
        info->end_y_mm;

    executor->segment_start_tangent_x =
        info->start_tangent_x;

    executor->segment_start_tangent_y =
        info->start_tangent_y;

    executor->segment_end_tangent_x =
        info->end_tangent_x;

    executor->segment_end_tangent_y =
        info->end_tangent_y;

    executor->segment_length_mm =
        info->length_mm;
}


static bool trajectory_executor_tangents_continuous(
    float ax,
    float ay,
    float bx,
    float by)
{
    const float dot =
        trajectory_executor_clampf(
            (ax * bx) + (ay * by),
            -1.0f,
            1.0f);

    const float threshold =
        cosf(
            TRAJECTORY_EXECUTOR_TANGENT_TOLERANCE_DEG *
            TRAJECTORY_EXECUTOR_DEG_TO_RAD);

    return dot >= threshold;
}


static esp_err_t trajectory_executor_prepare_current(
    trajectory_executor_t *executor,
    float logical_start_x_mm,
    float logical_start_y_mm)
{
    trajectory_executor_geometry_info_t info = {0};

    const esp_err_t ret =
        trajectory_executor_geometry_info(
            &executor->current_segment,
            logical_start_x_mm,
            logical_start_y_mm,
            &info,
            true);

    if (ret != ESP_OK)
    {
        if (ret == ESP_ERR_INVALID_RESPONSE)
        {
            ESP_LOGE(
                TRAJECTORY_EXECUTOR_TAG,
                "Segment %lu start is discontinuous",
                (unsigned long)executor->current_index);

            return trajectory_executor_fail(
                executor,
                TRAJECTORY_EXECUTOR_ERROR_DISCONTINUITY,
                ret,
                NULL);
        }

        ESP_LOGE(
            TRAJECTORY_EXECUTOR_TAG,
            "Invalid geometry in segment %lu (%s)",
            (unsigned long)executor->current_index,
            trajectory_decoder_segment_type_name(
                executor->current_segment.type));

        return trajectory_executor_fail(
            executor,
            TRAJECTORY_EXECUTOR_ERROR_INVALID_GEOMETRY,
            ret,
            NULL);
    }

    trajectory_executor_store_current_geometry(
        executor,
        &info);

    return ESP_OK;
}


static esp_err_t trajectory_executor_validate_next(
    trajectory_executor_t *executor,
    trajectory_executor_geometry_info_t *next_info)
{
    if (!executor->next_valid)
    {
        if (next_info != NULL)
        {
            memset(
                next_info,
                0,
                sizeof(*next_info));
        }

        return ESP_OK;
    }

    trajectory_executor_geometry_info_t info = {0};

    const esp_err_t ret =
        trajectory_executor_geometry_info(
            &executor->next_segment,
            executor->segment_end_x_mm,
            executor->segment_end_y_mm,
            &info,
            true);

    if (ret != ESP_OK)
    {
        if (ret == ESP_ERR_INVALID_RESPONSE)
        {
            ESP_LOGE(
                TRAJECTORY_EXECUTOR_TAG,
                "Segment %lu -> %lu position discontinuity",
                (unsigned long)executor->current_index,
                (unsigned long)(executor->current_index + 1U));

            return trajectory_executor_fail(
                executor,
                TRAJECTORY_EXECUTOR_ERROR_DISCONTINUITY,
                ret,
                NULL);
        }

        ESP_LOGE(
            TRAJECTORY_EXECUTOR_TAG,
            "Invalid lookahead geometry in segment %lu",
            (unsigned long)(executor->current_index + 1U));

        return trajectory_executor_fail(
            executor,
            TRAJECTORY_EXECUTOR_ERROR_INVALID_GEOMETRY,
            ret,
            NULL);
    }

    if (next_info != NULL)
    {
        *next_info = info;
    }

    return ESP_OK;
}


static esp_err_t trajectory_executor_update_exit_speed(
    trajectory_executor_t *executor)
{
    executor->exit_speed_mm_s =
        0.0f;

    if (!executor->next_valid)
    {
        return ESP_OK;
    }

    trajectory_executor_geometry_info_t next_info = {0};

    esp_err_t ret =
        trajectory_executor_validate_next(
            executor,
            &next_info);

    if (ret != ESP_OK)
    {
        return ret;
    }

    if (trajectory_executor_tangents_continuous(
            executor->segment_end_tangent_x,
            executor->segment_end_tangent_y,
            next_info.start_tangent_x,
            next_info.start_tangent_y))
    {
        float junction_speed =
            trajectory_executor_minf(
                executor->current_segment.speed_mm_s,
                executor->next_segment.speed_mm_s);

        /*
         * Conservative one-segment braking guard.
         *
         * We do not know next-next geometry yet, so cap the junction speed to
         * a value from which the NEXT segment could still stop by its own end.
         * This only changes short segments; on normal-length tangent chains the
         * speed is still simply min(current vmax, next vmax).
         */
        const float next_accel =
            trajectory_executor_segment_acceleration_limit(
                &executor->next_segment);

        if (!(next_accel > 0.0f) || !isfinite(next_accel))
        {
            return trajectory_executor_fail(
                executor,
                TRAJECTORY_EXECUTOR_ERROR_INVALID_GEOMETRY,
                ESP_ERR_INVALID_ARG,
                "Invalid lookahead acceleration limit");
        }

        const float next_stop_cap =
            sqrtf(
                2.0f * next_accel *
                next_info.length_mm);

        junction_speed =
            trajectory_executor_minf(
                junction_speed,
                next_stop_cap);

        executor->exit_speed_mm_s =
            junction_speed;
    }

    return ESP_OK;
}


static esp_err_t trajectory_executor_read_next_cache(
    trajectory_executor_t *executor)
{
    executor->next_valid =
        false;

    memset(
        &executor->next_segment,
        0,
        sizeof(executor->next_segment));

    if (!trajectory_decoder_has_next(
            executor->decoder))
    {
        return ESP_OK;
    }

    const esp_err_t ret =
        trajectory_decoder_read_next(
            executor->decoder,
            &executor->next_segment);

    if (ret != ESP_OK)
    {
        return trajectory_executor_fail(
            executor,
            TRAJECTORY_EXECUTOR_ERROR_DECODER,
            ret,
            "Failed to read lookahead segment");
    }

    executor->next_valid =
        true;

    return ESP_OK;
}


static esp_err_t trajectory_executor_load_first(
    trajectory_executor_t *executor)
{
    if (!trajectory_decoder_has_next(
            executor->decoder))
    {
        return ESP_ERR_NOT_FOUND;
    }

    esp_err_t ret =
        trajectory_decoder_read_next(
            executor->decoder,
            &executor->current_segment);

    if (ret != ESP_OK)
    {
        return trajectory_executor_fail(
            executor,
            TRAJECTORY_EXECUTOR_ERROR_DECODER,
            ret,
            "Failed to read first segment");
    }

    executor->current_valid = true;
    executor->current_index = 0U;

    ret =
        trajectory_executor_prepare_current(
            executor,
            executor->header.start_x_mm,
            executor->header.start_y_mm);

    if (ret != ESP_OK)
    {
        return ret;
    }

    ret =
        trajectory_executor_read_next_cache(
            executor);

    if (ret != ESP_OK)
    {
        return ret;
    }

    return trajectory_executor_update_exit_speed(
        executor);
}


static esp_err_t trajectory_executor_advance_segment(
    trajectory_executor_t *executor)
{
    if (!executor->next_valid)
    {
        executor->state =
            TRAJECTORY_EXECUTOR_FINISHED;

        executor->speed_mm_s = 0.0f;
        executor->acceleration_mm_s2 = 0.0f;
        executor->pending_advance = false;

        return ESP_OK;
    }

    const float inherited_speed =
        executor->speed_mm_s;

    const float logical_start_x =
        executor->segment_end_x_mm;

    const float logical_start_y =
        executor->segment_end_y_mm;

    executor->current_segment =
        executor->next_segment;

    executor->current_index++;
    executor->current_valid = true;
    executor->next_valid = false;

    executor->s_mm = 0.0f;
    executor->speed_mm_s = inherited_speed;
    executor->acceleration_mm_s2 = 0.0f;
    executor->first_reference = true;
    executor->pending_advance = false;

    esp_err_t ret =
        trajectory_executor_prepare_current(
            executor,
            logical_start_x,
            logical_start_y);

    if (ret != ESP_OK)
    {
        return ret;
    }

    ret =
        trajectory_executor_read_next_cache(
            executor);

    if (ret != ESP_OK)
    {
        return ret;
    }

    ret =
        trajectory_executor_update_exit_speed(
            executor);

    if (ret != ESP_OK)
    {
        return ret;
    }

    /*
     * Defensive feasibility guard.
     *
     * One-segment lookahead cannot know a future corner beyond next_segment.
     * If an inherited speed is already too high to reach this segment's
     * planned exit speed within its length, clamp the nominal speed to the
     * maximum physically compatible value instead of letting the reference
     * overshoot the segment end.
     */
    const float accel =
        trajectory_executor_segment_acceleration_limit(
            &executor->current_segment);

    if (!(accel > 0.0f) || !isfinite(accel))
    {
        return trajectory_executor_fail(
            executor,
            TRAJECTORY_EXECUTOR_ERROR_INVALID_GEOMETRY,
            ESP_ERR_INVALID_ARG,
            "Invalid executor acceleration limit");
    }

    const float max_entry_speed_sq =
        executor->exit_speed_mm_s *
        executor->exit_speed_mm_s +
        2.0f * accel *
        executor->segment_length_mm;

    const float max_entry_speed =
        sqrtf(
            (max_entry_speed_sq > 0.0f) ?
            max_entry_speed_sq : 0.0f);

    if (executor->speed_mm_s > max_entry_speed)
    {
        ESP_LOGW(
            TRAJECTORY_EXECUTOR_TAG,
            "Segment %lu inherited speed %.1f exceeds braking feasibility %.1f; clamped",
            (unsigned long)executor->current_index,
            executor->speed_mm_s,
            max_entry_speed);

        executor->speed_mm_s =
            max_entry_speed;
    }

    return ESP_OK;
}


static esp_err_t trajectory_executor_sample_current(
    const trajectory_executor_t *executor,
    float s_mm,
    float speed_mm_s,
    float acceleration_mm_s2,
    bool segment_start,
    bool segment_end,
    bool trajectory_end,
    trajectory_reference_t *reference)
{
    if ((executor == NULL) ||
        (reference == NULL) ||
        !executor->current_valid)
    {
        return ESP_ERR_INVALID_ARG;
    }

    trajectory_executor_clear_reference(
        reference);

    const float s =
        trajectory_executor_clampf(
            s_mm,
            0.0f,
            executor->segment_length_mm);

    reference->valid = true;
    reference->segment_index = executor->current_index;
    reference->source_type = executor->current_segment.type;
    reference->speed_mm_s =
        (speed_mm_s > 0.0f) ? speed_mm_s : 0.0f;
    reference->acceleration_mm_s2 = acceleration_mm_s2;
    reference->s_mm = s;
    reference->segment_length_mm = executor->segment_length_mm;
    reference->progress =
        (executor->segment_length_mm > 0.0f) ?
        trajectory_executor_clampf(
            s / executor->segment_length_mm,
            0.0f,
            1.0f) :
        1.0f;

    reference->segment_start = segment_start;
    reference->segment_end = segment_end;
    reference->trajectory_end = trajectory_end;

    switch (executor->current_segment.type)
    {
        case TRAJECTORY_SEGMENT_LINE:
        {
            reference->x_mm =
                executor->segment_start_x_mm +
                executor->segment_start_tangent_x * s;

            reference->y_mm =
                executor->segment_start_y_mm +
                executor->segment_start_tangent_y * s;

            reference->tangent_x =
                executor->segment_start_tangent_x;

            reference->tangent_y =
                executor->segment_start_tangent_y;

            reference->curvature_inv_mm =
                0.0f;

            if (segment_end)
            {
                reference->x_mm = executor->segment_end_x_mm;
                reference->y_mm = executor->segment_end_y_mm;
            }

            return ESP_OK;
        }

        case TRAJECTORY_SEGMENT_CIRCLE:
        {
            const trajectory_circle_t *circle =
                &executor->current_segment.geometry.circle;

            const float direction =
                (circle->sweep_deg > 0.0f) ? 1.0f : -1.0f;

            float theta =
                circle->start_angle_deg *
                TRAJECTORY_EXECUTOR_DEG_TO_RAD +
                direction * (s / circle->radius_mm);

            if (segment_end)
            {
                theta =
                    (circle->start_angle_deg + circle->sweep_deg) *
                    TRAJECTORY_EXECUTOR_DEG_TO_RAD;
            }

            const float theta_trig =
                trajectory_executor_wrap_rad_pi(theta);

            const float sin_theta =
                sinf(theta_trig);

            const float cos_theta =
                cosf(theta_trig);

            reference->x_mm =
                circle->center_x_mm +
                circle->radius_mm * cos_theta;

            reference->y_mm =
                circle->center_y_mm +
                circle->radius_mm * sin_theta;

            reference->tangent_x =
                direction * (-sin_theta);

            reference->tangent_y =
                direction * cos_theta;

            reference->curvature_inv_mm =
                direction / circle->radius_mm;

            if (segment_end)
            {
                reference->x_mm = executor->segment_end_x_mm;
                reference->y_mm = executor->segment_end_y_mm;
                reference->tangent_x = executor->segment_end_tangent_x;
                reference->tangent_y = executor->segment_end_tangent_y;
            }

            return ESP_OK;
        }

        default:
            return ESP_ERR_NOT_SUPPORTED;
    }
}


static esp_err_t trajectory_executor_make_stationary_reference(
    trajectory_executor_t *executor,
    trajectory_reference_t *reference)
{
    if ((executor == NULL) || (reference == NULL))
    {
        return ESP_ERR_INVALID_ARG;
    }

    if (executor->current_valid)
    {
        const bool at_end =
            executor->s_mm >=
            executor->segment_length_mm -
            TRAJECTORY_EXECUTOR_LENGTH_EPSILON_MM;

        const bool trajectory_end =
            executor->state == TRAJECTORY_EXECUTOR_FINISHED;

        return trajectory_executor_sample_current(
            executor,
            executor->s_mm,
            0.0f,
            0.0f,
            false,
            at_end,
            trajectory_end,
            reference);
    }

    trajectory_executor_clear_reference(
        reference);

    reference->valid = true;
    reference->source_type = TRAJECTORY_SEGMENT_NONE;
    reference->x_mm = executor->header.start_x_mm;
    reference->y_mm = executor->header.start_y_mm;
    reference->progress = 1.0f;
    reference->trajectory_end =
        executor->state == TRAJECTORY_EXECUTOR_FINISHED;

    return ESP_OK;
}


static esp_err_t trajectory_executor_profile_substep(
    trajectory_executor_t *executor,
    float dt_s,
    bool *reached_end)
{
    if ((executor == NULL) ||
        (reached_end == NULL) ||
        !(dt_s > 0.0f))
    {
        return ESP_ERR_INVALID_ARG;
    }

    *reached_end = false;

    const float accel_limit =
        trajectory_executor_segment_acceleration_limit(
            &executor->current_segment);

    if (!(accel_limit > 0.0f) ||
        !isfinite(accel_limit))
    {
        return trajectory_executor_fail(
            executor,
            TRAJECTORY_EXECUTOR_ERROR_INVALID_GEOMETRY,
            ESP_ERR_INVALID_ARG,
            "Invalid acceleration limit");
    }

    float remaining =
        executor->segment_length_mm -
        executor->s_mm;

    if (remaining <=
        TRAJECTORY_EXECUTOR_LENGTH_EPSILON_MM)
    {
        executor->s_mm =
            executor->segment_length_mm;

        executor->speed_mm_s =
            executor->exit_speed_mm_s;

        executor->acceleration_mm_s2 =
            0.0f;

        *reached_end = true;

        return ESP_OK;
    }

    const float brake_speed_sq =
        executor->exit_speed_mm_s *
        executor->exit_speed_mm_s +
        2.0f * accel_limit * remaining;

    const float brake_speed =
        sqrtf(
            (brake_speed_sq > 0.0f) ?
            brake_speed_sq : 0.0f);

    const float target_speed =
        trajectory_executor_minf(
            executor->current_segment.speed_mm_s,
            brake_speed);

    const float old_speed =
        executor->speed_mm_s;

    const float max_delta_v =
        accel_limit * dt_s;

    float new_speed = old_speed;

    if (target_speed > old_speed)
    {
        new_speed =
            trajectory_executor_minf(
                target_speed,
                old_speed + max_delta_v);
    }
    else if (target_speed < old_speed)
    {
        const float candidate =
            old_speed - max_delta_v;

        new_speed =
            (candidate > target_speed) ?
            candidate : target_speed;
    }

    if (new_speed < 0.0f)
    {
        new_speed = 0.0f;
    }

    float ds =
        0.5f *
        (old_speed + new_speed) *
        dt_s;

    if (!isfinite(ds) || (ds < 0.0f))
    {
        return trajectory_executor_fail(
            executor,
            TRAJECTORY_EXECUTOR_ERROR_INVALID_GEOMETRY,
            ESP_FAIL,
            "Non-finite motion-profile step");
    }

    if (ds >= remaining)
    {
        executor->s_mm =
            executor->segment_length_mm;

        executor->speed_mm_s =
            executor->exit_speed_mm_s;

        executor->acceleration_mm_s2 =
            (executor->speed_mm_s - old_speed) / dt_s;

        *reached_end = true;

        return ESP_OK;
    }

    executor->s_mm += ds;

    remaining =
        executor->segment_length_mm -
        executor->s_mm;

    /*
     * After advancing s, re-apply the exact braking envelope. This prevents
     * finite-step integration from carrying a speed that cannot still reach
     * exit_speed at the segment endpoint.
     */
    const float safe_speed_sq =
        executor->exit_speed_mm_s *
        executor->exit_speed_mm_s +
        2.0f * accel_limit *
        ((remaining > 0.0f) ? remaining : 0.0f);

    const float safe_speed =
        sqrtf(
            (safe_speed_sq > 0.0f) ?
            safe_speed_sq : 0.0f);

    if (new_speed > safe_speed)
    {
        new_speed = safe_speed;
    }

    executor->speed_mm_s = new_speed;
    executor->acceleration_mm_s2 =
        (new_speed - old_speed) / dt_s;

    return ESP_OK;
}


esp_err_t trajectory_executor_init(
    trajectory_executor_t *executor,
    trajectory_decoder_t *decoder)
{
    if ((executor == NULL) || (decoder == NULL))
    {
        return ESP_ERR_INVALID_ARG;
    }

    trajectory_file_header_t header = {0};

    const esp_err_t ret =
        trajectory_decoder_get_header(
            decoder,
            &header);

    if (ret != ESP_OK)
    {
        return ret;
    }

    memset(
        executor,
        0,
        sizeof(*executor));

    executor->initialized = true;
    executor->decoder = decoder;
    executor->header = header;
    executor->state = TRAJECTORY_EXECUTOR_IDLE;
    executor->error = TRAJECTORY_EXECUTOR_ERROR_NONE;

    return ESP_OK;
}


esp_err_t trajectory_executor_start(
    trajectory_executor_t *executor)
{
    if (executor == NULL)
    {
        return ESP_ERR_INVALID_ARG;
    }

    if (!executor->initialized ||
        (executor->decoder == NULL))
    {
        executor->error =
            TRAJECTORY_EXECUTOR_ERROR_NOT_INITIALIZED;

        return ESP_ERR_INVALID_STATE;
    }

    if ((executor->state == TRAJECTORY_EXECUTOR_RUNNING) ||
        (executor->state == TRAJECTORY_EXECUTOR_PAUSED))
    {
        return ESP_ERR_INVALID_STATE;
    }

    trajectory_file_header_t header = {0};

    esp_err_t ret =
        trajectory_decoder_get_header(
            executor->decoder,
            &header);

    if (ret != ESP_OK)
    {
        return trajectory_executor_fail(
            executor,
            TRAJECTORY_EXECUTOR_ERROR_DECODER,
            ret,
            "Failed to read trajectory header");
    }

    ret =
        trajectory_decoder_rewind(
            executor->decoder);

    if (ret != ESP_OK)
    {
        return trajectory_executor_fail(
            executor,
            TRAJECTORY_EXECUTOR_ERROR_DECODER,
            ret,
            "Failed to rewind trajectory decoder");
    }

    executor->header = header;
    executor->state = TRAJECTORY_EXECUTOR_IDLE;
    executor->error = TRAJECTORY_EXECUTOR_ERROR_NONE;
    executor->current_valid = false;
    executor->next_valid = false;
    executor->current_index = 0U;
    executor->s_mm = 0.0f;
    executor->speed_mm_s = 0.0f;
    executor->acceleration_mm_s2 = 0.0f;
    executor->exit_speed_mm_s = 0.0f;
    executor->first_reference = false;
    executor->pending_advance = false;

    memset(
        &executor->current_segment,
        0,
        sizeof(executor->current_segment));

    memset(
        &executor->next_segment,
        0,
        sizeof(executor->next_segment));

    trajectory_executor_clear_reference(
        &executor->last_reference);

    if (header.segment_count == 0U)
    {
        executor->state =
            TRAJECTORY_EXECUTOR_FINISHED;

        trajectory_executor_make_stationary_reference(
            executor,
            &executor->last_reference);

        ESP_LOGI(
            TRAJECTORY_EXECUTOR_TAG,
            "Started empty trajectory: already finished");

        return ESP_OK;
    }

    ret =
        trajectory_executor_load_first(
            executor);

    if (ret != ESP_OK)
    {
        return ret;
    }

    executor->state =
        TRAJECTORY_EXECUTOR_RUNNING;

    executor->first_reference =
        true;

    ret =
        trajectory_executor_sample_current(
            executor,
            0.0f,
            0.0f,
            0.0f,
            true,
            false,
            false,
            &executor->last_reference);

    if (ret != ESP_OK)
    {
        return trajectory_executor_fail(
            executor,
            TRAJECTORY_EXECUTOR_ERROR_INVALID_GEOMETRY,
            ret,
            "Failed to sample first reference");
    }

    ESP_LOGI(
        TRAJECTORY_EXECUTOR_TAG,
        "Started trajectory: segments=%lu start=(%.1f, %.1f, %.1f deg)",
        (unsigned long)header.segment_count,
        header.start_x_mm,
        header.start_y_mm,
        header.start_yaw_deg);

    return ESP_OK;
}


esp_err_t trajectory_executor_update(
    trajectory_executor_t *executor,
    float dt_s,
    trajectory_reference_t *reference)
{
    if ((executor == NULL) || (reference == NULL))
    {
        return ESP_ERR_INVALID_ARG;
    }

    trajectory_executor_clear_reference(
        reference);

    if (!executor->initialized)
    {
        executor->error =
            TRAJECTORY_EXECUTOR_ERROR_NOT_INITIALIZED;

        return ESP_ERR_INVALID_STATE;
    }

    if (!isfinite(dt_s) ||
        !(dt_s > 0.0f) ||
        (dt_s > TRAJECTORY_EXECUTOR_UPDATE_DT_MAX_S))
    {
        return trajectory_executor_fail(
            executor,
            TRAJECTORY_EXECUTOR_ERROR_INVALID_DT,
            ESP_ERR_INVALID_ARG,
            "Invalid trajectory executor dt");
    }

    if (executor->state == TRAJECTORY_EXECUTOR_ERROR)
    {
        return ESP_ERR_INVALID_STATE;
    }

    if (executor->state == TRAJECTORY_EXECUTOR_IDLE)
    {
        return ESP_ERR_INVALID_STATE;
    }

    if ((executor->state == TRAJECTORY_EXECUTOR_PAUSED) ||
        (executor->state == TRAJECTORY_EXECUTOR_FINISHED))
    {
        esp_err_t ret =
            trajectory_executor_make_stationary_reference(
                executor,
                reference);

        if (ret == ESP_OK)
        {
            executor->last_reference =
                *reference;
        }

        return ret;
    }

    if (!executor->current_valid)
    {
        return trajectory_executor_fail(
            executor,
            TRAJECTORY_EXECUTOR_ERROR_INVALID_GEOMETRY,
            ESP_ERR_INVALID_STATE,
            "RUNNING without a current segment");
    }

    if (executor->pending_advance)
    {
        esp_err_t ret =
            trajectory_executor_advance_segment(
                executor);

        if (ret != ESP_OK)
        {
            return ret;
        }

        if (executor->state == TRAJECTORY_EXECUTOR_FINISHED)
        {
            ret =
                trajectory_executor_make_stationary_reference(
                    executor,
                    reference);

            if (ret == ESP_OK)
            {
                executor->last_reference =
                    *reference;
            }

            return ret;
        }
    }

    float dt_remaining = dt_s;
    bool reached_end = false;

    while (dt_remaining > 0.0f)
    {
        const float step =
            (dt_remaining >
             TRAJECTORY_EXECUTOR_PROFILE_SUBSTEP_MAX_S) ?
            TRAJECTORY_EXECUTOR_PROFILE_SUBSTEP_MAX_S :
            dt_remaining;

        esp_err_t ret =
            trajectory_executor_profile_substep(
                executor,
                step,
                &reached_end);

        if (ret != ESP_OK)
        {
            return ret;
        }

        dt_remaining -= step;

        if (reached_end)
        {
            break;
        }
    }

    const bool first_reference =
        executor->first_reference;

    executor->first_reference =
        false;

    bool trajectory_end = false;

    if (reached_end)
    {
        trajectory_end =
            !executor->next_valid;

        executor->pending_advance =
            !trajectory_end;

        if (trajectory_end)
        {
            executor->state =
                TRAJECTORY_EXECUTOR_FINISHED;

            executor->speed_mm_s = 0.0f;
            executor->acceleration_mm_s2 = 0.0f;
        }
    }

    esp_err_t ret =
        trajectory_executor_sample_current(
            executor,
            executor->s_mm,
            executor->speed_mm_s,
            executor->acceleration_mm_s2,
            first_reference,
            reached_end,
            trajectory_end,
            reference);

    if (ret != ESP_OK)
    {
        return trajectory_executor_fail(
            executor,
            TRAJECTORY_EXECUTOR_ERROR_INVALID_GEOMETRY,
            ret,
            "Failed to sample trajectory reference");
    }

    executor->last_reference =
        *reference;

    return ESP_OK;
}


esp_err_t trajectory_executor_pause(
    trajectory_executor_t *executor)
{
    if (executor == NULL)
    {
        return ESP_ERR_INVALID_ARG;
    }

    if (!executor->initialized)
    {
        return ESP_ERR_INVALID_STATE;
    }

    if (executor->state != TRAJECTORY_EXECUTOR_RUNNING)
    {
        return ESP_ERR_INVALID_STATE;
    }

    executor->state =
        TRAJECTORY_EXECUTOR_PAUSED;

    executor->speed_mm_s = 0.0f;
    executor->acceleration_mm_s2 = 0.0f;

    executor->last_reference.speed_mm_s = 0.0f;
    executor->last_reference.acceleration_mm_s2 = 0.0f;

    return ESP_OK;
}


esp_err_t trajectory_executor_resume(
    trajectory_executor_t *executor)
{
    if (executor == NULL)
    {
        return ESP_ERR_INVALID_ARG;
    }

    if (!executor->initialized ||
        (executor->state != TRAJECTORY_EXECUTOR_PAUSED))
    {
        return ESP_ERR_INVALID_STATE;
    }

    executor->state =
        TRAJECTORY_EXECUTOR_RUNNING;

    executor->speed_mm_s = 0.0f;
    executor->acceleration_mm_s2 = 0.0f;

    return ESP_OK;
}


void trajectory_executor_stop(
    trajectory_executor_t *executor)
{
    if ((executor == NULL) || !executor->initialized)
    {
        return;
    }

    executor->state =
        TRAJECTORY_EXECUTOR_IDLE;

    executor->error =
        TRAJECTORY_EXECUTOR_ERROR_NONE;

    executor->current_valid = false;
    executor->next_valid = false;
    executor->s_mm = 0.0f;
    executor->speed_mm_s = 0.0f;
    executor->acceleration_mm_s2 = 0.0f;
    executor->exit_speed_mm_s = 0.0f;
    executor->first_reference = false;
    executor->pending_advance = false;

    trajectory_executor_clear_reference(
        &executor->last_reference);
}


bool trajectory_executor_is_running(
    const trajectory_executor_t *executor)
{
    return
        (executor != NULL) &&
        executor->initialized &&
        (executor->state == TRAJECTORY_EXECUTOR_RUNNING);
}


bool trajectory_executor_is_finished(
    const trajectory_executor_t *executor)
{
    return
        (executor != NULL) &&
        executor->initialized &&
        (executor->state == TRAJECTORY_EXECUTOR_FINISHED);
}


trajectory_executor_state_t trajectory_executor_get_state(
    const trajectory_executor_t *executor)
{
    if ((executor == NULL) || !executor->initialized)
    {
        return TRAJECTORY_EXECUTOR_IDLE;
    }

    return executor->state;
}


trajectory_executor_error_t trajectory_executor_get_error(
    const trajectory_executor_t *executor)
{
    if ((executor == NULL) || !executor->initialized)
    {
        return TRAJECTORY_EXECUTOR_ERROR_NOT_INITIALIZED;
    }

    return executor->error;
}


esp_err_t trajectory_executor_get_reference(
    const trajectory_executor_t *executor,
    trajectory_reference_t *reference)
{
    if ((executor == NULL) || (reference == NULL))
    {
        return ESP_ERR_INVALID_ARG;
    }

    if (!executor->initialized ||
        (executor->state == TRAJECTORY_EXECUTOR_IDLE) ||
        (executor->state == TRAJECTORY_EXECUTOR_ERROR))
    {
        return ESP_ERR_INVALID_STATE;
    }

    *reference =
        executor->last_reference;

    return ESP_OK;
}


esp_err_t trajectory_executor_get_header(
    const trajectory_executor_t *executor,
    trajectory_file_header_t *header)
{
    if ((executor == NULL) || (header == NULL))
    {
        return ESP_ERR_INVALID_ARG;
    }

    if (!executor->initialized)
    {
        return ESP_ERR_INVALID_STATE;
    }

    *header =
        executor->header;

    return ESP_OK;
}


const char *trajectory_executor_state_name(
    trajectory_executor_state_t state)
{
    switch (state)
    {
        case TRAJECTORY_EXECUTOR_IDLE:
            return "IDLE";

        case TRAJECTORY_EXECUTOR_RUNNING:
            return "RUNNING";

        case TRAJECTORY_EXECUTOR_PAUSED:
            return "PAUSED";

        case TRAJECTORY_EXECUTOR_FINISHED:
            return "FINISHED";

        case TRAJECTORY_EXECUTOR_ERROR:
            return "ERROR";

        default:
            return "UNKNOWN";
    }
}


const char *trajectory_executor_error_name(
    trajectory_executor_error_t error)
{
    switch (error)
    {
        case TRAJECTORY_EXECUTOR_ERROR_NONE:
            return "NONE";

        case TRAJECTORY_EXECUTOR_ERROR_NOT_INITIALIZED:
            return "NOT_INITIALIZED";

        case TRAJECTORY_EXECUTOR_ERROR_INVALID_ARGUMENT:
            return "INVALID_ARGUMENT";

        case TRAJECTORY_EXECUTOR_ERROR_DECODER:
            return "DECODER";

        case TRAJECTORY_EXECUTOR_ERROR_INVALID_GEOMETRY:
            return "INVALID_GEOMETRY";

        case TRAJECTORY_EXECUTOR_ERROR_DISCONTINUITY:
            return "DISCONTINUITY";

        case TRAJECTORY_EXECUTOR_ERROR_INVALID_DT:
            return "INVALID_DT";

        default:
            return "UNKNOWN";
    }
}


#ifdef __cplusplus
}
#endif

#endif /* TRAJECTORY_EXECUTOR_IMPLEMENTATION */

#endif /* TRAJECTORY_EXECUTOR_H */
